VERSION ""

NS_ :

BS_:

BU_: IPC BCM
VAL_TABLE_ Switch 1 "ON" 0 "OFF" ;

BO_ 260 IPCMessage_L: 1 IPC
 SG_ IPC_Signal_L : 1|1@1+ (1,0) [0|1] "" Vector__XXX

BO_ 259 IPCMessage_R: 1 IPC
 SG_ IPC_Signal_R : 1|1@1+ (1,0) [0|1] "" Vector__XXX

BO_ 257 BCMMessage_R: 1 BCM
 SG_ BCM_Signal_R : 0|1@1+ (1,0) [0|1] "" Vector__XXX

BO_ 256 BCMMessage_L: 1 BCM
 SG_ BCM_Signal_L : 0|1@1+ (1,0) [0|3] "" Vector__XXX

VAL_ 260 IPC_Signal_L 1 "ON" 0 "OFF" ;
VAL_ 259 IPC_Signal_R 1 "ON" 0 "OFF" ;
VAL_ 257 BCM_Signal_R 1 "ON" 0 "OFF" ;
VAL_ 256 BCM_Signal_L 1 "ON" 0 "OFF" ;
