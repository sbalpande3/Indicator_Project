VERSION ""

NS_ :

BS_:

BU_: IPC BCM
VAL_TABLE_ Switch 3 "Hazard" 2 "Right" 1 "Left" 0 "OFF" ;

BO_ 3221225472 VECTOR__INDEPENDENT_SIG_MSG: 0 Vector__XXX
 SG_ IPC_Signal : 0|2@1+ (1,0) [0|3] "" Vector__XXX

BO_ 257 IPCMessage: 8 IPC

BO_ 256 BCMMessage: 1 BCM
 SG_ BCM_Signal : 0|2@1+ (1,0) [0|3] "" Vector__XXX

CM_ BO_ 3221225472 "This is a message for not used signals, created by Vector CANdb++ DBC OLE DB Provider.";
VAL_ 3221225472 IPC_Signal 3 "Hazard" 2 "Right" 1 "Left" 0 "OFF" ;
VAL_ 256 BCM_Signal 3 "Hazard" 2 "Right" 1 "Left" 0 "OFF" ;
